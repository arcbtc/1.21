
//includes
#include <ArduinoHttpClient.h>
#include <WiFi.h>
#include <ArduinoJson.h>
#include <qrcode.h>
#include <string.h>
#include <GxEPD.h>
#include <GxGDEP015OC1/GxGDEP015OC1.h>  
#include <GxIO/GxIO_SPI/GxIO_SPI.h>
#include <GxIO/GxIO.h>

//Set Arduino Strings for amount of Sats, description and API key
String invoiceamounts = "400";
String invoicedescription = "sweets";
String strikeapikey = "YourStrikeAPIKey";

//Wifi details
char SSID = "YourWIFISSID";
char PASS = "YourWIFIPASS";


//Set other Arduino Strings used
String setoffour = "";
String right = "";
String third = "";
String fourth = "";
String tempfourhex = "";
String line = "";
String line2 = "";
String doublelines = "";
String finalhex = "";
String hexvalues = "";
String result = "";
String PAYMENT = ""; 
String PAYMENTPAID = "true"; 
String response;

//Buffers for Arduino String conversions
char fourbuf[5];
char fourbuff[5];
int tamp = 0;

//Char for holding the QR byte array
unsigned char PROGMEM singlehex[4209];

//Char dictionary for conversion from 1s and 0s
char ref[2][16][5]={
{"0000","0001","0010","0011","0100","0101","0110","0111","1000","1001","1010","1011","1100","1101","1110","1111"},
{"0",   "1",   "2",   "3",   "4",   "5",   "6",   "7",   "8",   "9",   "a",   "b",   "c",   "d",   "e",   "f"}
};

//Server to connect to
char serverAddress[] = "api.strike.acinq.co";  // server address

//Define pins for SPI communication with epaper module
GxIO_Class io(SPI, SS, 22, 21);
GxEPD_Class display(io, 16, 4);

//Char byte array of the lightning bolt image used by the waveshare epaper (for more details, https://www.waveshare.com/wiki/1.54inch_e-Paper_Module)
const unsigned char lightningbolt [] = {
  0xff, 0xff, 0xff, 0xff, 0xff, 0xff, 0xff, 0xff, 0xff, 0xff, 0xff, 0xff, 0xff, 0xff, 0xff, 0xff, 
  0xff, 0xff, 0xff, 0xff, 0xff, 0xff, 0xff, 0xff, 0xff, 0xff, 0xff, 0xff, 0xff, 0xff, 0xff, 0xff, 
  0xff, 0xff, 0xff, 0xff, 0xff, 0xff, 0xff, 0xff, 0xff, 0xff, 0xff, 0xff, 0xff, 0xff, 0xff, 0xff, 
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  0xff, 0xff, 0xff, 0xff, 0xff, 0xff, 0xff, 0xff
};


WiFiClient wifi;
HttpClient client = HttpClient(wifi, serverAddress);
int status = WL_IDLE_STATUS;
int statusCode = 0;

//Setup loop
void setup() {

//Start epaper display
  display.init(115200); 

//Start Serial monitor 
  Serial.begin(115200);                  

//connect to local wifi            
  WiFi.begin(SSID, PASS);   
  while (WiFi.status() != WL_CONNECTED) {  
    delay(500);
    Serial.println(".");
  }

//initialise GPIO 17
  pinMode(17, OUTPUT);
}


//Main loop
void loop() {

//Clear hexvalues
hexvalues = "";

//Checks to see if the QR has been paid
 if (PAYMENTPAID == "true"){  

//Collects a new payment request from Acinq   
  fetchpay();      
  Serial.println(PAYMENT);

//makes QR code, QR code is ruturned as 1s and 0s in  String line
  qrmmaker(PAYMENT);
  
//1s and 0s are parsed through dictionary to build hex values
     for (int i = 0;  i < line.length(); i+=4){      
        int tmp = i; 
        setoffour = line.substring(tmp, tmp+4); 
       
             for (int z = 0; z < 16; z++){
               if (setoffour == ref[0][z]){
                hexvalues += ref[1][z];
               }
             }
      }

//Clear line
  line = "";

//for loop to build the epaper friendly char singlehex byte array image of the QR
  for (int i = 0;  i < 4209; i++){
     int tmp = i;   
     int pmt = tmp*2; 
     result = "0x" + hexvalues.substring(pmt, pmt+2) + ",";
     singlehex[tmp] = (unsigned char)strtol(hexvalues.substring(pmt, pmt+2).c_str(), NULL, 16);
  }

//turns GPIO 17 on for an amount of time
  digitalWrite(17, HIGH);
  delay(4000);
  digitalWrite(17, LOW);
  delay(500);

//Refreshers the epaper with a new QR
  display.fillScreen(GxEPD_WHITE);
  display.drawExampleBitmap(lightningbolt, 0, 0, 200, 200, GxEPD_BLACK); 
  display.update(); 
  delay(1000);
  display.fillScreen(GxEPD_WHITE);
  display.drawExampleBitmap(singlehex, 7, 7, 184, 183, GxEPD_BLACK); 
  display.update(); 


 }

 else{
   Serial.println("Waiting for QR to be paid");
  
 }
   
  delay(100);

  checkpay ();

}


//Function to check if the QR has been paid
void checkpay () {
  client.beginRequest();
  client.get("/api/v1/charges?size=1");
  client.sendBasicAuth(strikeapikey, strikeapikey);   
  client.endRequest();
  
  String response1 = client.responseBody();
  response = response1.substring(1, response1.length() - 1);

  StaticJsonBuffer<2000> jsonBuffer;
  JsonObject& root = jsonBuffer.parseObject(response);

  String paymentpaid = root["paid"];
  jsonBuffer.clear();
  response = "";
  PAYMENTPAID = paymentpaid;

  
}

//Function to ask for a new payment request 
void fetchpay() {
  client.beginRequest();
  String contentType = "application/x-www-form-urlencoded";
  String postData = "?POST&amount=" + invoiceamount + "&currency=btc&description=" + invoicedescription;
  client.post("/api/v1/charges");
  client.sendHeader("Content-Type", "application/x-www-form-urlencoded");
  client.sendHeader("Content-Length", postData.length());
  client.sendBasicAuth(strikeapikey, strikeapikey); 
  client.beginBody();
  client.print(postData);
  client.endRequest();
  
  response = client.responseBody();

  StaticJsonBuffer<2000> jsonBuffer;
  JsonObject& root = jsonBuffer.parseObject(response);

  String paymentpaid = root["paid"];
  PAYMENTPAID = paymentpaid;
  String paymentreq = root["payment_request"];
  PAYMENT = paymentreq;
  jsonBuffer.clear();
  response = "";
}

// QR maker function
void qrmmaker(String xxx){

int str_len = xxx.length() + 1; 
char xxxx[str_len];
xxx.toCharArray(xxxx, str_len);

    // Start time
    uint32_t dt = millis();
  
    // Create the QR code
    QRCode qrcode;
    uint8_t qrcodeData[qrcode_getBufferSize(11)];
    qrcode_initText(&qrcode, qrcodeData, 11, 0, xxxx);
  
    // Delta time
    dt = millis() - dt;
    Serial.print("QR Code Generation Time: ");
    Serial.print(dt);
    Serial.print("\n");

    int une = 0;
    
    line = "";

    for (uint8_t y = 0; y < qrcode.size; y++) {

        // Each horizontal module
        for (uint8_t x = 0; x < qrcode.size; x++) {
          line += (qrcode_getModule(&qrcode, x, y) ? "000": "111");
        }
        line += "0";
        for (uint8_t x = 0; x < qrcode.size; x++) {
          line += (qrcode_getModule(&qrcode, x, y) ? "000": "111");
        }
        line += "0";
        for (uint8_t x = 0; x < qrcode.size; x++) {
          line += (qrcode_getModule(&qrcode, x, y) ? "000": "111");
        }
        line += "0";    
    }
}
